// Prince of Persia title screen data.
const byte data[] PROGMEM = {
111,
111,
111,
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111,
111
};

int a0 = 2;
int a1 = 3;
int a2 = 4;
int a3 = 5;
int a4 = 6;
int a5 = 7;
int a6 = 8;
int a7 = 9;
int a8 = 10;
int a9 = 11;
int a10 = 12;
int a11 = A0;
int a12 = A1;
int a13 = A2;
int a14 = A3;

int r = A4;
int g = A5;
int b = A6;

int interrupt = A7;

void setup() {
  pinMode(a0, OUTPUT);
  pinMode(a1, OUTPUT);
  pinMode(a2, OUTPUT);
  pinMode(a3, OUTPUT);
  pinMode(a4, OUTPUT);
  pinMode(a5, OUTPUT);
  pinMode(a6, OUTPUT);
  pinMode(a7, OUTPUT);
  pinMode(a8, OUTPUT);
  pinMode(a9, OUTPUT);
  pinMode(a10, OUTPUT);
  pinMode(a11, OUTPUT);
  pinMode(a12, OUTPUT);
  pinMode(a13, OUTPUT);
  pinMode(a14, OUTPUT);

  pinMode(r, OUTPUT);
  pinMode(g, OUTPUT);
  pinMode(b, OUTPUT);

  pinMode(interrupt, OUTPUT);

  digitalWrite(interrupt, 0);
}

void loop() {
  for (int i=0; i<30000; i++) {
    digitalWrite(a0, bitRead(i,0));
    digitalWrite(a1, bitRead(i,1));
    digitalWrite(a2, bitRead(i,2));
    digitalWrite(a3, bitRead(i,3));
    digitalWrite(a4, bitRead(i,4));
    digitalWrite(a5, bitRead(i,5));
    digitalWrite(a6, bitRead(i,6));
    digitalWrite(a7, bitRead(i,7));
    digitalWrite(a8, bitRead(i,8));
    digitalWrite(a9, bitRead(i,9));
    digitalWrite(a10, bitRead(i,10));
    digitalWrite(a11, bitRead(i,11));
    digitalWrite(a12, bitRead(i,12));
    digitalWrite(a13, bitRead(i,13));
    digitalWrite(a14, bitRead(i,14));

    // Add any necessary leading zeros to color data.
    String val = String(pgm_read_byte_near(data + i));
    if (val.length() == 1) {
      val = "00" + val;
    } else if (val.length() == 2) {
      val = "0" + val;
    }

    // Extract and transform RGB values.
    int rv = val.charAt(2);
    int gv = val.charAt(1);
    int bv = val.charAt(0);    
    if (rv == 49) { rv = 1; } else { rv = 0; }
    if (gv == 49) { gv = 1; } else { gv = 0; }
    if (bv == 49) { bv = 1; } else { bv = 0; }
    
    digitalWrite(r, rv);
    digitalWrite(g, gv);
    digitalWrite(b, bv);
    
    digitalWrite(interrupt, 1);
    digitalWrite(interrupt, 0);
  }

  while(true) {}
}
